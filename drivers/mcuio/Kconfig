## drivers/mcuio/Kconfig
```kconfig
menuconfig MCUIO
	tristate "mcuio drivers"
	select REGMAP_MCUIO
	help
	  MCUIO is a protocol and a set of drivers which let a Linux MPU
	  (MPU = MicroProcessor Unit) control an MCU's peripherals
	  (MCU = Micro Controller Unit, some kind of tiny microcontroller
	  running a tiny OS or no OS at all).

config MCUIO_LDISC_HC
	tristate "mcuio line discipline host controller"
	depends on MCUIO
	default y
	help
	  This adds a line-discipline based MCUIO host controller, which is
	  the only host controller at present. Say Y if in doubt.

config MCUIO_JS_SHIELD
	tristate "mcuio joystick shield driver"
	depends on (MCUIO && MCUIO_IRQ_CTRL)
	default y
	help
	  Adds a driver for a joystick + buttons shield (experimental)

config MCUIO_LUCKY_SHIELD
	tristate "mcuio lucky shield driver"
	depends on (MCUIO && MCUIO_IRQ_CTRL && I2C)
	default y
	help
	  Adds a driver for the Dog Hunter Lucky shield (experimental)

config MCUIO_DIGITALIO_SHIELD
	tristate "mcuio Digital I/O shield driver"
	depends on (MCUIO && MCUIO_IRQ_CTRL && I2C)
	default y
	help
	  Adds a driver for the Dog Hunter Lucky shield (experimental)

config MCUIO_SHIELDS_MANUAL_PROBE
	tristate "mcuio shields manual probe"
	depends on (MCUIO_LUCKY_SHIELD || MCUIO_DIGITALIO_SHIELD)
	default y
	help
	  Since autoprobe of mcuio shields is not implemented yet, this option
	  makes it possible to manually register shields (experimental).

config MCUIO_ADC
	tristate "mcuio ADC driver"
	depends on MCUIO
	default y
	help
	  Adds a driver for analog to digital converters (experimental)

config MCUIO_IRQ_TEST
        tristate "mcuio irq test function driver"
	depends on MCUIO
	default n
	help
	  Adds a driver for the irq test mcuio function
```
